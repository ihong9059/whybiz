## CMakeLists.txt
```
#
# Copyright (c) 2018 Nordic Semiconductor
#
# SPDX-License-Identifier: LicenseRef-Nordic-5-Clause
#
cmake_minimum_required(VERSION 3.20.0)

find_package(Zephyr REQUIRED HINTS $ENV{ZEPHYR_BASE})
project(NONE)

# NORDIC SDK APP START
target_sources(app PRIVATE
  src/main.c
  src/uttec.c 
  src/myBle.c 
  src/sx1509.c 
  src/nvm.c
)

# Include UART ASYNC API adapter
target_sources_ifdef(CONFIG_BT_NUS_UART_ASYNC_ADAPTER app PRIVATE
  src/uart_async_adapter.c
)

# NORDIC SDK APP END

zephyr_library_include_directories(.)
```

## prj.conf
```kconfig
#
# Copyright (c) 2018 Nordic Semiconductor
#
# SPDX-License-Identifier: LicenseRef-Nordic-5-Clause
#

# Enable the UART driver
CONFIG_UART_ASYNC_API=y
CONFIG_NRFX_UARTE0=y
CONFIG_SERIAL=y

CONFIG_GPIO=y

# Make sure printk is printing to the UART console
CONFIG_CONSOLE=y
CONFIG_UART_CONSOLE=y

CONFIG_HEAP_MEM_POOL_SIZE=2048

CONFIG_BT=y
CONFIG_BT_PERIPHERAL=y
CONFIG_BT_DEVICE_NAME="Whybiz 11/29"
CONFIG_BT_DEVICE_APPEARANCE=833
CONFIG_BT_MAX_CONN=1
CONFIG_BT_MAX_PAIRED=1

# Enable the NUS service
CONFIG_BT_NUS=y

# Enable bonding
CONFIG_BT_SETTINGS=y
CONFIG_FLASH=y
CONFIG_FLASH_PAGE_LAYOUT=y
CONFIG_FLASH_MAP=y
CONFIG_NVS=y
CONFIG_SETTINGS=y

CONFIG_REBOOT=y
CONFIG_MPU_ALLOW_FLASH_WRITE=y



# Enable DK LED and Buttons library
CONFIG_DK_LIBRARY=y

# This example requires more stack
CONFIG_MAIN_STACK_SIZE=1152
CONFIG_SYSTEM_WORKQUEUE_STACK_SIZE=2048

# Config logger
CONFIG_LOG=y
CONFIG_USE_SEGGER_RTT=y
CONFIG_LOG_BACKEND_RTT=y
CONFIG_LOG_BACKEND_UART=n
CONFIG_LOG_PRINTK=y

CONFIG_ASSERT=y

CONFIG_JSON_LIBRARY=y

CONFIG_I2C=y
CONFIG_ADC=y

# for float print
CONFIG_CBPRINTF_FP_SUPPORT=y
```

## src/main.c
```c
/*
 * Copyright (c) 2018 Nordic Semiconductor ASA
 *
 * SPDX-License-Identifier: LicenseRef-Nordic-5-Clause
 */

/** @file
 *  @brief Nordic UART Bridge Service (NUS) sample
#define BT_UUID_NUS_SERVICE   BT_UUID_DECLARE_128(BT_UUID_NUS_VAL)
#define BT_UUID_NUS_RX        BT_UUID_DECLARE_128(BT_UUID_NUS_RX_VAL)
#define BT_UUID_NUS_TX        BT_UUID_DECLARE_128(BT_UUID_NUS_TX_VAL)

 * 
 */
// test0
#include "uart_async_adapter.h"

#include <zephyr/types.h>
#include <zephyr/kernel.h>
#include <zephyr/drivers/uart.h>
#include <zephyr/usb/usb_device.h>

#include <zephyr/device.h>
#include <zephyr/devicetree.h>
#include <soc.h>

// #include <zephyr/bluetooth/bluetooth.h>
// #include <zephyr/bluetooth/uuid.h>
// #include <zephyr/bluetooth/gatt.h>
// #include <zephyr/bluetooth/hci.h>

// #include <bluetooth/services/nus.h>

#include <dk_buttons_and_leds.h>

// #include <zephyr/settings/settings.h>

#include <stdio.h>

#include <zephyr/logging/log.h>

#include "uttec.h"
#include "myBle.h"
#include "sx1509.h"

#include <zephyr/drivers/gpio.h>
#include <zephyr/drivers/adc.h>


#define RUN_LED_BLINK_INTERVAL 1000
#define RUN_STATUS_LED DK_LED1

#define RED_LED_NODE DT_NODELABEL(led1)
static const struct gpio_dt_spec redLed = GPIO_DT_SPEC_GET(RED_LED_NODE, gpios);

#define RS485_EN_NODE DT_NODELABEL(led3)
static const struct gpio_dt_spec rs485En = GPIO_DT_SPEC_GET(RS485_EN_NODE, gpios);

#define BLUE_LED_NODE DT_NODELABEL(led4)
static const struct gpio_dt_spec greenLed = GPIO_DT_SPEC_GET(BLUE_LED_NODE, gpios);

#define SELECT1_NODE DT_NODELABEL(select1)
static const struct gpio_dt_spec select1 = GPIO_DT_SPEC_GET(SELECT1_NODE, gpios);

#define SELECT2_NODE DT_NODELABEL(select2)
static const struct gpio_dt_spec select2 = GPIO_DT_SPEC_GET(SELECT2_NODE, gpios);

#define PWR_CTL_NODE DT_NODELABEL(pwrctl)
static const struct gpio_dt_spec pwrCtl = GPIO_DT_SPEC_GET(PWR_CTL_NODE, gpios);

#define LORA_RESET_NODE DT_NODELABEL(lorarst)
static const struct gpio_dt_spec loraRst = GPIO_DT_SPEC_GET(LORA_RESET_NODE, gpios);

#define SX1509_RESET_NODE DT_NODELABEL(sx1509rst)
static const struct gpio_dt_spec sx1509Rst = GPIO_DT_SPEC_GET(SX1509_RESET_NODE, gpios);

#define ADC DT_NODELABEL(adc)
static const struct device *adc_dev = DEVICE_DT_GET(ADC);

#define ADC_RESOLUTION 	10
#define ADC0_CHANNEL	0
#define ADC1_CHANNEL	2
#define ADC0_PORT		SAADC_CH_PSELN_PSELN_AnalogInput0
#define ADC1_PORT		SAADC_CH_PSELN_PSELN_AnalogInput2
#define ADC_REFERENCE	ADC_REF_INTERNAL
#define ADC_GAIN		ADC_GAIN_1_6 

struct adc_channel_cfg ch0_cfg = {
	.gain = ADC_GAIN,
	.reference = ADC_REFERENCE,
	.acquisition_time = ADC_ACQ_TIME_DEFAULT,
	.channel_id = ADC0_CHANNEL,
#ifdef CONFIG_ADC_NRFX_SAADC
	.input_positive = ADC0_PORT
#endif 	
}; 
struct adc_channel_cfg ch1_cfg = {
	.gain = ADC_GAIN,
	.reference = ADC_REFERENCE,
	.acquisition_time = ADC_ACQ_TIME_DEFAULT,
	.channel_id = ADC1_CHANNEL,
#ifdef CONFIG_ADC_NRFX_SAADC
	.input_positive = ADC1_PORT
#endif 	
}; 

int16_t sample_buffer[2];
struct adc_sequence sequence = {
	.channels = BIT(ADC0_CHANNEL) | BIT(ADC1_CHANNEL),
	// .channels = BIT(ADC0_CHANNEL),
	.buffer = sample_buffer,
	.buffer_size = sizeof(sample_buffer),
	.resolution = ADC_RESOLUTION
};

#include "nvm.h"

int main(void)
{
	int blink_status = 0;
// 	BT_UUID_128_ENCODE(0x6e400001, 0xb5a3, 0xf393, 0xe0a9, 0xe50e24dcca9e)
// 	Service UUID: 			6e400001-b5a3-f393-e0a9-e50e24dcca9e
// 	Tx Characteristic UUID: 6e400003-b5a3-f393-e0a9-e50e24dcca9e
// 	Rx Characteristic UUID: 6e400002-b5a3-f393-e0a9-e50e24dcca9e
// test2
	// uttecTest();
	initBle();
	// initSx1509();
	if(!device_is_ready(adc_dev)){
		printf("adc_dev is not ready.");
	}
	int err = adc_channel_setup(adc_dev, &ch0_cfg);
	err = adc_channel_setup(adc_dev, &ch1_cfg);
	
	initNvm();
	nvmTest();

	for (;;) {
		static bool toggle = false;
		dk_set_led(RUN_STATUS_LED, (++blink_status) % 2);
		k_sleep(K_MSEC(RUN_LED_BLINK_INTERVAL));
		callPrint();
		uttecTest();
		printf("pin num: %d\r\n", greenLed.pin);
		if(toggle){
			gpio_pin_set_dt(&greenLed, 0);
			gpio_pin_set_dt(&redLed, 0);
			gpio_pin_set_dt(&select1, 0);
			gpio_pin_set_dt(&select2, 0);

			gpio_pin_set_dt(&rs485En, 0);
			gpio_pin_set_dt(&pwrCtl, 0);
			gpio_pin_set_dt(&loraRst, 0);
			gpio_pin_set_dt(&sx1509Rst, 0);
		}
		else{
			gpio_pin_set_dt(&greenLed, 1);
			gpio_pin_set_dt(&redLed, 1);
			gpio_pin_set_dt(&select1, 1);
			gpio_pin_set_dt(&select2, 1);

			gpio_pin_set_dt(&rs485En, 1);
			gpio_pin_set_dt(&pwrCtl, 1);
			gpio_pin_set_dt(&loraRst, 1);
			gpio_pin_set_dt(&sx1509Rst, 1);
		}
		toggle = !toggle;
		err = adc_read(adc_dev, &sequence);
		if(err != 0){
			printf("ADC reading failed with error %d\r\n", err);
			return 0;
		}
		int32_t mv_value = sample_buffer[0];
		int32_t adc_vref = adc_ref_internal(adc_dev);
		adc_raw_to_millivolts(adc_vref, ADC_GAIN, ADC_RESOLUTION, &mv_value);
		printf("ADC-spanning: %d mV\r\n", mv_value);

		int32_t mv_value1 = sample_buffer[1];
		adc_raw_to_millivolts(adc_vref, ADC_GAIN, ADC_RESOLUTION, &mv_value1);
		printf("ADC-spanning: %d mV\r\n", mv_value1);
		nvmTest();
		// testI2c();
	}
}
```

## src/nvm.c
```c
#include <zephyr/kernel.h>
#include <zephyr/sys/reboot.h>
#include <zephyr/device.h>
#include <string.h>
#include <zephyr/drivers/flash.h>
#include <zephyr/storage/flash_map.h>
#include <zephyr/fs/nvs.h>

#include "nvm.h"

static struct nvs_fs fs;

#define NVS_PARTITION		storage_partition
#define NVS_PARTITION_DEVICE	FIXED_PARTITION_DEVICE(NVS_PARTITION)
#define NVS_PARTITION_OFFSET	FIXED_PARTITION_OFFSET(NVS_PARTITION)

#define UTTEC_ID 1 

static uttec_t myUttec = {0, };

void initNvm(void){
    int rc = 0;
	struct flash_pages_info info;

	/* define the nvs file system by settings with:
	 *	sector_size equal to the pagesize,
	 *	3 sectors
	 *	starting at NVS_PARTITION_OFFSET
	 */
	fs.flash_device = NVS_PARTITION_DEVICE;
	if (!device_is_ready(fs.flash_device)) {
		printf("Flash device %s is not ready\n", fs.flash_device->name);
	}
	fs.offset = NVS_PARTITION_OFFSET;
	rc = flash_get_page_info_by_offs(fs.flash_device, fs.offset, &info);
	if (rc) {
		printf("Unable to get page info\n");
	}
	fs.sector_size = info.size;
	fs.sector_count = 3U;

	rc = nvs_mount(&fs);
	if (rc) {
		printf("Flash Init failed\n");
	}

	rc = nvs_read(&fs, UTTEC_ID, &myUttec, sizeof(myUttec));
	if (rc > 0) { /* item was found, show it */
		printf("version: %d, temp0: %d\n", myUttec.version, myUttec.temp0);
        printf("data: %s\r\n", myUttec.data);
	} else   {/* item was not found, add it */
        myUttec.version = 1234;
        myUttec.temp0 = 4321;
        for(int i = 0; i < 10; i++){
            myUttec.data[i] = 'a' + i;
        }
		(void)nvs_write(&fs, UTTEC_ID, &myUttec, sizeof(myUttec)+1);
	}
}

void checkFactor(void){
    int rc = 0;

	rc = nvs_read(&fs, UTTEC_ID, &myUttec, sizeof(myUttec));
	if (rc > 0) { /* item was found, show it */
		printf("version: %d, temp0: %d\n", myUttec.version, myUttec.temp0);
        printf("data: %s\r\n", myUttec.data);
	} else   {/* item was not found, add it */
        myUttec.version = 1;
        myUttec.temp0 = 1;
        for(int i = 0; i < 10; i++){
            myUttec.data[i] = 'a' + i;
        }
		(void)nvs_write(&fs, UTTEC_ID, &myUttec, sizeof(myUttec)+1);
	}
}

uttec_t* getFactor(void){
	return &myUttec;
}

void writeFactor(void){
	(void)nvs_write(&fs, UTTEC_ID, &myUttec, sizeof(myUttec)+1);
}

void nvmTest(void){
	uttec_t* pFactor = getFactor();
	printf("version: %d\r\n", pFactor->version);
	pFactor->version++;
	writeFactor();
}
```

## src/nvm.h
```c
#ifndef NVM__H__
#define NVM__H__

typedef struct{
    uint16_t version;
    uint16_t temp0;
    uint8_t data[10];
} uttec_t;


void initNvm(void);

void nvmTest(void);

uttec_t* getFactor(void);
void writeFactor(void);


#endif 
```

## src/sx1509.c
```c
#include <zephyr/kernel.h>
#include <zephyr/drivers/gpio.h>
#include <zephyr/sys/printk.h>
#include <zephyr/devicetree.h> 
#include <zephyr/drivers/i2c.h>

#define SX1509_ADDRESS		0x3e
#define I2C_NODE DT_NODELABEL(arduino_i2c)
static const struct device *i2c0_dev = DEVICE_DT_GET(I2C_NODE);

void initSx1509(void){
	int err;
	uint8_t buf[2];

	if(!device_is_ready(i2c0_dev)){
		printf("i2c_dev is not ready ----------->\r\n");
	}
	printf("<--------- pass i2c device\r\n");

	// buf[0] = 0x00; buf[1] = 0xff; //port b, input disable	
	buf[0] = 0x00; buf[1] = 0x00; //port b, input enable	
	err = i2c_write(i2c0_dev, buf, 2, SX1509_ADDRESS);
	if(err < 0){
		printf("i2c write fail------------\r\n");
		// return 0;
	}
	buf[0] = 0x01; buf[1] = 0x00; //port a, input enable
	// buf[0] = 0x01; buf[1] = 0xff; //port a, input disable
	err = i2c_write(i2c0_dev, buf, 2, SX1509_ADDRESS);
	if(err < 0){
		printf("i2c write fail------------\r\n");
		// return 0;
	}

	buf[0] = 0x06; buf[1] = 0xff; //port b, pull up
	err = i2c_write(i2c0_dev, buf, 2, SX1509_ADDRESS);
	if(err < 0){
		printf("i2c write fail------------\r\n");
		// return 0;
	}
	buf[0] = 0x07; buf[1] = 0xff; //port a, pull up
	err = i2c_write(i2c0_dev, buf, 2, SX1509_ADDRESS);
	if(err < 0){
		printf("i2c write fail------------\r\n");
		// return 0;
	}

	buf[0] = 0x0e; buf[1] = 0x00; //port b, output
	err = i2c_write(i2c0_dev, buf, 2, SX1509_ADDRESS);
	if(err < 0){
		printf("i2c write fail------------\r\n");
		// return 0;
	}
	buf[0] = 0x0f; buf[1] = 0xff; //port a, input
	err = i2c_write(i2c0_dev, buf, 2, SX1509_ADDRESS);
	if(err < 0){
		printf("i2c write fail------------\r\n");
		// return 0;
	}
	printf("end of initSx1509\r\n");

}

static uint8_t sx1509_in = 0;
// 0x10(regB), 0x11(regA)
#define BIT_0 0B11111110
#define BIT_1 0B11111101
#define BIT_2 0B11111011
#define BIT_3 0B11110111
#define BIT_4 0B11101111
#define BIT_5 0B11011111
#define BIT_6 0B10111111
#define BIT_7 0B01111111

bool isSwitchOn_0(void){
	uint8_t sw = sx1509_in | BIT_0;
	if(sw == BIT_0) return true;
	return false;
}

bool isSwitchOn_1(void){
	uint8_t sw = sx1509_in | BIT_1;
	if(sw == BIT_1) return true;
	return false;
}

bool isSwitchOn_2(void){
	uint8_t sw = sx1509_in | BIT_2;
	if(sw == BIT_2) return true;
	return false;
}

bool isSwitchOn_3(void){
	uint8_t sw = sx1509_in | BIT_3;
	if(sw == BIT_3) return true;
	return false;
}

bool isSwitchOn_4(void){
	uint8_t sw = sx1509_in | BIT_4;
	if(sw == BIT_4) return true;
	return false;
}

bool isSwitchOn_5(void){
	uint8_t sw = sx1509_in | BIT_5;
	if(sw == BIT_5) return true;
	return false;
}

bool isSwitchOn_6(void){
	uint8_t sw = sx1509_in | BIT_6;
	if(sw == BIT_6) return true;
	return false;
}

bool isSwitchOn_7(void){
	uint8_t sw = sx1509_in | BIT_7;
	if(sw == BIT_7) return true;
	return false;
}

void readIn(void){
	int err;
	uint8_t buf = 0x11;

	err = i2c_write(i2c0_dev, &buf, 1, SX1509_ADDRESS);
	if(err < 0){
		printf("i2c write fail------------\r\n");
	}
	err = i2c_read(i2c0_dev, &buf, 1, SX1509_ADDRESS);
	if(err < 0){
		printf("i2c write fail------------\r\n");
	}
	sx1509_in = buf;
}

uint8_t readOut(void){
	int err;
	uint8_t buf = 0x10;

	err = i2c_write(i2c0_dev, &buf, 1, SX1509_ADDRESS);
	if(err < 0){
		printf("i2c write fail------------\r\n");
	}
	err = i2c_read(i2c0_dev, &buf, 1, SX1509_ADDRESS);
	if(err < 0){
		printf("i2c write fail------------\r\n");
	}
	printf("read buf: %x\r\n", buf);
	return buf;
}

void writeOut(uint8_t bitNum, bool output){
	uint8_t regB = readOut();
	// uint8_t regB = 0;
	int err;
	printf("~BIT_0: %x\r\n", (uint8_t)~BIT_0);

	switch(bitNum){
		case 0:
			if(output) regB = regB | (uint8_t)~BIT_0;
			else regB = regB & BIT_0;
		break;
		case 1:
			if(output) regB = regB | (uint8_t)~BIT_1;
			else regB = regB & BIT_1;
		break;
		case 2:
			if(output) regB = regB | (uint8_t)~BIT_2;
			else regB = regB & BIT_2;
		break;
		case 3:
			if(output) regB = regB | (uint8_t)~BIT_3;
			else regB = regB & BIT_3;
		break;
		case 4:
			if(output) regB = regB | (uint8_t)~BIT_4;
			else regB = regB & BIT_4;
		break;
		case 5:
			if(output) regB = regB | (uint8_t)~BIT_5;
			else regB = regB & BIT_5;
		break;
		case 6:
			if(output) regB = regB | (uint8_t)~BIT_6;
			else regB = regB & BIT_6;
		break;
		case 7:
			if(output) regB = regB | (uint8_t)~BIT_7;
			else regB = regB & BIT_7;
		break;
	}
	uint8_t buf[2];
	buf[0] = 0x10; buf[1] = regB; //regB, all high
	err = i2c_write(i2c0_dev, buf, 2, SX1509_ADDRESS);
	if(err < 0){
		printf("i2c write fail------------\r\n");
	}
	printf("regB: %x\r\n", regB);
}

void testI2c(void){
	static bool toggle = true;
	static uint16_t count = 0;
	switch(count%16){
		case 0: writeOut(count%8, true); break;
		case 1: writeOut(count%8, true); break;
		case 2: writeOut(count%8, true); break;
		case 3: writeOut(count%8, true); break;
		case 4: writeOut(count%8, true); break;
		case 5: writeOut(count%8, true); break;
		case 6: writeOut(count%8, true); break;
		case 7: writeOut(count%8, true); break;
		case 8: writeOut(count%8, false); break;
		case 9: writeOut(count%8, false); break;
		case 10: writeOut(count%8, false); break;
		case 11: writeOut(count%8, false); break;
		case 12: writeOut(count%8, false); break;
		case 13: writeOut(count%8, false); break;
		case 14: writeOut(count%8, false); break;
		case 15: writeOut(count%8, false); break;
	}
	count++;
	toggle = !toggle;
	printf("12345----------------\r\n");
	readIn();
	if(isSwitchOn_0()){
		printf("Switch1_On\r\n");
	}
	else{
		printf("Switch1_Off\r\n");
	}
}
```
