## bleUart/build/Kconfig/Kconfig.shield
```kconfig
osource "c:/project/whybiz/bleuart/boards/shields/*/Kconfig.shield"
osource "C:/ncs/v2.5.0/nrf/boards/shields/*/Kconfig.shield"
```

## bleUart/build/Kconfig/Kconfig.shield.defconfig
```kconfig
osource "c:/project/whybiz/bleuart/boards/shields/*/Kconfig.defconfig"
osource "C:/ncs/v2.5.0/nrf/boards/shields/*/Kconfig.defconfig"
```

## nordic/whybizBle/build/Kconfig/Kconfig.shield
```kconfig
osource "/Users/honggwangseon/project/whybiz/nordic/whybizBle/boards/shields/*/Kconfig.shield"
osource "/opt/nordic/ncs/v2.5.0/nrf/boards/shields/*/Kconfig.shield"
```

## nordic/whybizBle/build/Kconfig/Kconfig.shield.defconfig
```kconfig
osource "c:/project/whybiz/nordic/whybizble/boards/shields/*/Kconfig.defconfig"
osource "C:/ncs/v2.5.0/nrf/boards/shields/*/Kconfig.defconfig"
```

## whybiz/build/Kconfig/Kconfig.shield.defconfig
```kconfig
osource "c:/project/whybiz/whybiz/boards/shields/*/Kconfig.defconfig"
osource "C:/ncs/v2.5.0/nrf/boards/shields/*/Kconfig.defconfig"
```
