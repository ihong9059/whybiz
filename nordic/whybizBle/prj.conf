## CMakeLists.txt
```
#
# Copyright (c) 2018 Nordic Semiconductor
#
# SPDX-License-Identifier: LicenseRef-Nordic-5-Clause
#
cmake_minimum_required(VERSION 3.20.0)

find_package(Zephyr REQUIRED HINTS $ENV{ZEPHYR_BASE})
project(NONE)

# NORDIC SDK APP START
target_sources(app PRIVATE
  src/main.c
  src/uttec.c 
  src/myBle.c 
  src/sx1509.c 
  src/adc.c 
)

# Include UART ASYNC API adapter
target_sources_ifdef(CONFIG_BT_NUS_UART_ASYNC_ADAPTER app PRIVATE
  src/uart_async_adapter.c
)

# NORDIC SDK APP END

zephyr_library_include_directories(.)
```

## prj.conf
```kconfig
#
# Copyright (c) 2018 Nordic Semiconductor
#
# SPDX-License-Identifier: LicenseRef-Nordic-5-Clause
#

# Enable the UART driver
CONFIG_UART_ASYNC_API=y
CONFIG_NRFX_UARTE0=y
CONFIG_SERIAL=y

CONFIG_GPIO=y

# Make sure printk is printing to the UART console
CONFIG_CONSOLE=y
CONFIG_UART_CONSOLE=y

CONFIG_HEAP_MEM_POOL_SIZE=2048

CONFIG_BT=y
CONFIG_BT_PERIPHERAL=y
CONFIG_BT_DEVICE_NAME="Whybiz for nordic"
CONFIG_BT_DEVICE_APPEARANCE=833
CONFIG_BT_MAX_CONN=1
CONFIG_BT_MAX_PAIRED=1

# Enable the NUS service
CONFIG_BT_NUS=y

# Enable bonding
CONFIG_BT_SETTINGS=y
CONFIG_FLASH=y
CONFIG_FLASH_PAGE_LAYOUT=y
CONFIG_FLASH_MAP=y
CONFIG_NVS=y
CONFIG_SETTINGS=y

# Enable DK LED and Buttons library
CONFIG_DK_LIBRARY=y

# This example requires more stack
CONFIG_MAIN_STACK_SIZE=1152
CONFIG_SYSTEM_WORKQUEUE_STACK_SIZE=2048

# Config logger
CONFIG_LOG=y
CONFIG_USE_SEGGER_RTT=y
CONFIG_LOG_BACKEND_RTT=y
CONFIG_LOG_BACKEND_UART=n
CONFIG_LOG_PRINTK=y

CONFIG_ASSERT=y

CONFIG_JSON_LIBRARY=y

CONFIG_I2C=y

# for float print
CONFIG_CBPRINTF_FP_SUPPORT=y
```

## src/main.c
```c
#include "uart_async_adapter.h"

#include <zephyr/types.h>
#include <zephyr/kernel.h>
#include <zephyr/drivers/uart.h>

#include <zephyr/device.h>
#include <zephyr/devicetree.h>
#include <soc.h>

#include <stdio.h>
#include <zephyr/logging/log.h>

#include "uttec.h"
#include "myBle.h"
#include "sx1509.h"
#include "adc.h"
#include "nvm.h"

#define RUN_LED_BLINK_INTERVAL 500
#define RUN_STATUS_LED DK_LED1

connectFlag_t whybizConnect = {0, };
connectFlag_t* getConnectFlag(void){
	return &whybizConnect;
}

int main(void)
{
	printk("nordic for whybiz.\r\n");
	initBle();
	initSx1509();
	initAdc();
	initPort();
	initNvm();
	// connectFlag_t* pFlags = getConnectFlag();
	whybizConnect.first = true;
    // whybiz_t* pFactor = getWhybizFactor();

	for (;;) {
		static uint32_t count = 0;
		static bool toggle = false;

		// k_sleep(K_MSEC(RUN_LED_BLINK_INTERVAL));
		delay(500);
		// testJsonOut();
		jsonFrame_t* pFrame = getJsonFrame();
		if(pFrame->flag){
			uttecJsonTest(pFrame->frame, pFrame->end+1);// json test
			dispJsonFrame();
			k_sleep(K_MSEC(20));
			clearJsonData();
		}
		sendJsonForStatus();
		// procSwitchTxBle();
		// procRelayTxBle();
		// procAdcTxBle();
		// testNvm();	
		printk("main: %d\r\n", count);
		dispChannel();
		toggle = !toggle;
		count++;
	}
}
```

## src/adc.c
```c
#include "uart_async_adapter.h"

#include <zephyr/types.h>
#include <zephyr/kernel.h>
#include <zephyr/drivers/uart.h>
#include <zephyr/usb/usb_device.h>

#include <zephyr/device.h>
#include <zephyr/devicetree.h>
#include <soc.h>

#include <dk_buttons_and_leds.h>

#include <stdio.h>

#include <zephyr/logging/log.h>

#include "uttec.h"
#include "myBle.h"
#include "sx1509.h"

#include <zephyr/drivers/adc.h>

#define ADC DT_NODELABEL(adc)
static const struct device *adc_dev = DEVICE_DT_GET(ADC);

#define ADC_RESOLUTION 	10
#define ADC0_CHANNEL	0
#define ADC1_CHANNEL	2
#define ADC0_PORT		SAADC_CH_PSELN_PSELN_AnalogInput0
#define ADC1_PORT		SAADC_CH_PSELN_PSELN_AnalogInput2
#define ADC_REFERENCE	ADC_REF_INTERNAL
#define ADC_GAIN		ADC_GAIN_1_6 

struct adc_channel_cfg ch0_cfg = {
	.gain = ADC_GAIN,
	.reference = ADC_REFERENCE,
	.acquisition_time = ADC_ACQ_TIME_DEFAULT,
	.channel_id = ADC0_CHANNEL,
#ifdef CONFIG_ADC_NRFX_SAADC
	.input_positive = ADC0_PORT
#endif 	
}; 
struct adc_channel_cfg ch1_cfg = {
	.gain = ADC_GAIN,
	.reference = ADC_REFERENCE,
	.acquisition_time = ADC_ACQ_TIME_DEFAULT,
	.channel_id = ADC1_CHANNEL,
#ifdef CONFIG_ADC_NRFX_SAADC
	.input_positive = ADC1_PORT
#endif 	
}; 

int16_t sample_buffer[2];
struct adc_sequence sequence = {
	.channels = BIT(ADC0_CHANNEL) | BIT(ADC1_CHANNEL),
	// .channels = BIT(ADC0_CHANNEL),
	.buffer = sample_buffer,
	.buffer_size = sizeof(sample_buffer),
	.resolution = ADC_RESOLUTION
};

void initAdc(void){
	if(!device_is_ready(adc_dev)){
		printk("adc_dev is not ready.");
	}
	int err = adc_channel_setup(adc_dev, &ch0_cfg);
	err = adc_channel_setup(adc_dev, &ch1_cfg);
	
}

void testAdc(void){
    int err;
    err = adc_read(adc_dev, &sequence);
    if(err != 0){
        printk("ADC reading failed with error %d\r\n", err);
        return;
    }
    int32_t mv_value = sample_buffer[0];
    int32_t adc_vref = adc_ref_internal(adc_dev);
    adc_raw_to_millivolts(adc_vref, ADC_GAIN, ADC_RESOLUTION, &mv_value);
    printk("ADC-spanning: %d mV, %d\r\n", mv_value, sample_buffer[0]/10);

    int32_t mv_value1 = sample_buffer[1];
    adc_raw_to_millivolts(adc_vref, ADC_GAIN, ADC_RESOLUTION, &mv_value1);
    printk("ADC-spanning: %d mV, %d\r\n", mv_value1, sample_buffer[1]);    
}

void readAdcValue(void){
    int err;
    whybiz_t* pWhybiz = getWhybizFactor();
    err = adc_read(adc_dev, &sequence);
    if(err != 0){
        printf("ADC reading failed with error %d\r\n", err);
        return;
    }
    pWhybiz->adc1 = sample_buffer[0]/10;
    pWhybiz->adc2 = sample_buffer[1]/10;
    printk("Adc1: %d, Adc2: %d\r\n", 
        pWhybiz->adc1, pWhybiz->adc2);
}
```

## src/adc.h
```c
#ifndef ADC__H__
#define ADC__H__


void initAdc(void);
void sendAdcValue(void);
void readAdcValue(void);

void testAdc(void);


#endif 
```

## src/myBle.c
```c
#include "uart_async_adapter.h"

#include <zephyr/types.h>
#include <zephyr/kernel.h>
#include <zephyr/drivers/uart.h>
#include <zephyr/usb/usb_device.h>

#include <zephyr/device.h>
#include <zephyr/devicetree.h>
#include <soc.h>

#include <zephyr/bluetooth/bluetooth.h>
#include <zephyr/bluetooth/uuid.h>
#include <zephyr/bluetooth/gatt.h>
#include <zephyr/bluetooth/hci.h>

#include <bluetooth/services/nus.h>

#include <dk_buttons_and_leds.h>

#include <zephyr/settings/settings.h>

#include <stdio.h>

#include <zephyr/logging/log.h>

#include "myBle.h"
#include "uttec.h"
#include "sx1509.h"

#define LOG_MODULE_NAME peripheral_uart
LOG_MODULE_REGISTER(LOG_MODULE_NAME);

#define STACKSIZE CONFIG_BT_NUS_THREAD_STACK_SIZE
#define PRIORITY 7

// #define DEVICE_NAME CONFIG_BT_DEVICE_NAME
// #define DEVICE_NAME_LEN	(sizeof(DEVICE_NAME) - 1)

// #define RUN_STATUS_LED DK_LED1
// #define RUN_LED_BLINK_INTERVAL 3000

#define CON_STATUS_LED DK_LED2

#define KEY_PASSKEY_ACCEPT DK_BTN1_MSK
#define KEY_PASSKEY_REJECT DK_BTN2_MSK

// #define UART_BUF_SIZE CONFIG_BT_NUS_UART_BUFFER_SIZE
#define UART_BUF_SIZE 100
// #define UART_BUF_SIZE 200
#define UART_WAIT_FOR_BUF_DELAY K_MSEC(50)
#define UART_WAIT_FOR_RX CONFIG_BT_NUS_UART_RX_WAIT_TIME

static K_SEM_DEFINE(ble_init_ok, 0, 1);

static struct bt_conn *current_conn;
static struct bt_conn *auth_conn;

static const struct device *uart = DEVICE_DT_GET(DT_CHOSEN(nordic_nus_uart));
static struct k_work_delayable uart_work;


struct uart_data_t {
	void *fifo_reserved;
	uint8_t data[UART_BUF_SIZE];
	uint16_t len;
};

static K_FIFO_DEFINE(fifo_uart_tx_data);
static K_FIFO_DEFINE(fifo_uart_rx_data);

// static const struct bt_data ad[] = {
// 	BT_DATA_BYTES(BT_DATA_FLAGS, (BT_LE_AD_GENERAL | BT_LE_AD_NO_BREDR)),
// 	BT_DATA(BT_DATA_NAME_COMPLETE, DEVICE_NAME, DEVICE_NAME_LEN),
// };

static const struct bt_data sd[] = {
	BT_DATA_BYTES(BT_DATA_UUID128_ALL, BT_UUID_NUS_VAL),
};

#if CONFIG_BT_NUS_UART_ASYNC_ADAPTER
UART_ASYNC_ADAPTER_INST_DEFINE(async_adapter);
#else
static const struct device *const async_adapter;
#endif



static void uart_cb(const struct device *dev, struct uart_event *evt, void *user_data)
{
	ARG_UNUSED(dev);

	static size_t aborted_len;
	struct uart_data_t *buf;
	static uint8_t *aborted_buf;
	static bool disable_req;

	switch (evt->type) {
	case UART_TX_DONE:
		LOG_DBG("UART_TX_DONE");
		LOG_INF("UART_TX_DONE");
		if ((evt->data.tx.len == 0) ||
		    (!evt->data.tx.buf)) {
			return;
		}

		if (aborted_buf) {
			buf = CONTAINER_OF(aborted_buf, struct uart_data_t,
					   data);
			aborted_buf = NULL;
			aborted_len = 0;
		} else {
			buf = CONTAINER_OF(evt->data.tx.buf, struct uart_data_t,
					   data);
		}

		k_free(buf);

		buf = k_fifo_get(&fifo_uart_tx_data, K_NO_WAIT);
		if (!buf) {
			return;
		}

		if (uart_tx(uart, buf->data, buf->len, SYS_FOREVER_MS)) {
			LOG_WRN("Failed to send data over UART");
		}

		break;

	case UART_RX_RDY:
	// test0
		// LOG_DBG("UART_RX_RDY");
		// LOG_INF("UART_RX_RDY");
		buf = CONTAINER_OF(evt->data.rx.buf, struct uart_data_t, data);
		buf->len += evt->data.rx.len;

		if (disable_req) {
			return;
		}

		if ((evt->data.rx.buf[buf->len - 1] == '\n') ||
		    (evt->data.rx.buf[buf->len - 1] == '\r')) {
			// printk("<--%d\r\n", buf->len);	
			disable_req = true;
			uart_rx_disable(uart);
		}

		break;

	case UART_RX_DISABLED:
		LOG_DBG("UART_RX_DISABLED");
		disable_req = false;

		buf = k_malloc(sizeof(*buf));
		if (buf) {
			buf->len = 0;
		} else {
			LOG_WRN("Not able to allocate UART receive buffer");
			k_work_reschedule(&uart_work, UART_WAIT_FOR_BUF_DELAY);
			return;
		}

		uart_rx_enable(uart, buf->data, sizeof(buf->data),
			       UART_WAIT_FOR_RX);

		break;

	case UART_RX_BUF_REQUEST:
		LOG_DBG("UART_RX_BUF_REQUEST");
		buf = k_malloc(sizeof(*buf));
		if (buf) {
			buf->len = 0;
			uart_rx_buf_rsp(uart, buf->data, sizeof(buf->data));
		} else {
			LOG_WRN("Not able to allocate UART receive buffer");
		}

		break;

	case UART_RX_BUF_RELEASED:
		LOG_DBG("UART_RX_BUF_RELEASED");
		buf = CONTAINER_OF(evt->data.rx_buf.buf, struct uart_data_t,
				   data);

		if (buf->len > 0) {
			k_fifo_put(&fifo_uart_rx_data, buf);
		} else {
			k_free(buf);
		}

		break;

	case UART_TX_ABORTED:
		LOG_DBG("UART_TX_ABORTED");
		if (!aborted_buf) {
			aborted_buf = (uint8_t *)evt->data.tx.buf;
		}

		aborted_len += evt->data.tx.len;
		buf = CONTAINER_OF(aborted_buf, struct uart_data_t,
				   data);

		uart_tx(uart, &buf->data[aborted_len],
			buf->len - aborted_len, SYS_FOREVER_MS);

		break;

	default:
		break;
	}
}

static void uart_work_handler(struct k_work *item)
{
	struct uart_data_t *buf;

	buf = k_malloc(sizeof(*buf));
	if (buf) {
		buf->len = 0;
	} else {
		LOG_WRN("Not able to allocate UART receive buffer");
		k_work_reschedule(&uart_work, UART_WAIT_FOR_BUF_DELAY);
		return;
	}

	uart_rx_enable(uart, buf->data, sizeof(buf->data), UART_WAIT_FOR_RX);
}

static bool uart_test_async_api(const struct device *dev)
{
	const struct uart_driver_api *api =
			(const struct uart_driver_api *)dev->api;

	return (api->callback_set != NULL);
}

static int uart_init(void)
{
	int err;
	// int pos;
	struct uart_data_t *rx;
	struct uart_data_t *tx;

	if (!device_is_ready(uart)) {
		return -ENODEV;
	}

	if (IS_ENABLED(CONFIG_USB_DEVICE_STACK)) {
		err = usb_enable(NULL);
		if (err && (err != -EALREADY)) {
			LOG_ERR("Failed to enable USB");
			return err;
		}
	}

	rx = k_malloc(sizeof(*rx));
	if (rx) {
		rx->len = 0;
	} else {
		return -ENOMEM;
	}

	k_work_init_delayable(&uart_work, uart_work_handler);


	if (IS_ENABLED(CONFIG_BT_NUS_UART_ASYNC_ADAPTER) && !uart_test_async_api(uart)) {
		/* Implement API adapter */
		uart_async_adapter_init(async_adapter, uart);
		uart = async_adapter;
	}

	err = uart_callback_set(uart, uart_cb, NULL);
	if (err) {
		k_free(rx);
		LOG_ERR("Cannot initialize UART callback");
		return err;
	}

	if (IS_ENABLED(CONFIG_UART_LINE_CTRL)) {
		LOG_INF("Wait for DTR");
		while (true) {
			uint32_t dtr = 0;

			uart_line_ctrl_get(uart, UART_LINE_CTRL_DTR, &dtr);
			if (dtr) {
				break;
			}
			/* Give CPU resources to low priority threads. */
			k_sleep(K_MSEC(100));
		}
		LOG_INF("DTR set");
		err = uart_line_ctrl_set(uart, UART_LINE_CTRL_DCD, 1);
		if (err) {
			LOG_WRN("Failed to set DCD, ret code %d", err);
		}
		err = uart_line_ctrl_set(uart, UART_LINE_CTRL_DSR, 1);
		if (err) {
			LOG_WRN("Failed to set DSR, ret code %d", err);
		}
	}

	err = uart_rx_enable(uart, rx->data, sizeof(rx->data), 50);
	if (err) {
		LOG_ERR("Cannot enable uart reception (err: %d)", err);
		/* Free the rx buffer only because the tx buffer will be handled in the callback */
		k_free(rx);
	}

	return err;
}

static void connected(struct bt_conn *conn, uint8_t err)
{
	char addr[BT_ADDR_LE_STR_LEN];

	if (err) {
		LOG_ERR("Connection failed (err %u)", err);
		return;
	}
	connectFlag_t* pFlags = getConnectFlag();
	pFlags->ble = true;
	pFlags->first = false;

	bt_addr_le_to_str(bt_conn_get_dst(conn), addr, sizeof(addr));
	LOG_INF("Connected %s", addr);

	current_conn = bt_conn_ref(conn);

	dk_set_led_on(CON_STATUS_LED);
}

static void disconnected(struct bt_conn *conn, uint8_t reason)
{
	char addr[BT_ADDR_LE_STR_LEN];
	
	connectFlag_t* pFlags = getConnectFlag();
	pFlags->ble = false;

	bt_addr_le_to_str(bt_conn_get_dst(conn), addr, sizeof(addr));

	LOG_INF("Disconnected: %s (reason %u)", addr, reason);

	if (auth_conn) {
		bt_conn_unref(auth_conn);
		auth_conn = NULL;
	}

	if (current_conn) {
		bt_conn_unref(current_conn);
		current_conn = NULL;
		dk_set_led_off(CON_STATUS_LED);
	}
}

#ifdef CONFIG_BT_NUS_SECURITY_ENABLED
static void security_changed(struct bt_conn *conn, bt_security_t level,
			     enum bt_security_err err)
{
	char addr[BT_ADDR_LE_STR_LEN];

	bt_addr_le_to_str(bt_conn_get_dst(conn), addr, sizeof(addr));

	if (!err) {
		LOG_INF("Security changed: %s level %u", addr, level);
	} else {
		LOG_WRN("Security failed: %s level %u err %d", addr,
			level, err);
	}
}
#endif

BT_CONN_CB_DEFINE(conn_callbacks) = {
	.connected    = connected,
	.disconnected = disconnected,
#ifdef CONFIG_BT_NUS_SECURITY_ENABLED
	.security_changed = security_changed,
#endif
};

#if defined(CONFIG_BT_NUS_SECURITY_ENABLED)
static void auth_passkey_display(struct bt_conn *conn, unsigned int passkey)
{
	char addr[BT_ADDR_LE_STR_LEN];

	bt_addr_le_to_str(bt_conn_get_dst(conn), addr, sizeof(addr));

	LOG_INF("Passkey for %s: %06u", addr, passkey);
}

static void auth_passkey_confirm(struct bt_conn *conn, unsigned int passkey)
{
	char addr[BT_ADDR_LE_STR_LEN];

	auth_conn = bt_conn_ref(conn);

	bt_addr_le_to_str(bt_conn_get_dst(conn), addr, sizeof(addr));

	LOG_INF("Passkey for %s: %06u", addr, passkey);
	LOG_INF("Press Button 1 to confirm, Button 2 to reject.");
}


static void auth_cancel(struct bt_conn *conn)
{
	char addr[BT_ADDR_LE_STR_LEN];

	bt_addr_le_to_str(bt_conn_get_dst(conn), addr, sizeof(addr));

	LOG_INF("Pairing cancelled: %s", addr);
}


static void pairing_complete(struct bt_conn *conn, bool bonded)
{
	char addr[BT_ADDR_LE_STR_LEN];

	bt_addr_le_to_str(bt_conn_get_dst(conn), addr, sizeof(addr));

	LOG_INF("Pairing completed: %s, bonded: %d", addr, bonded);
}


static void pairing_failed(struct bt_conn *conn, enum bt_security_err reason)
{
	char addr[BT_ADDR_LE_STR_LEN];

	bt_addr_le_to_str(bt_conn_get_dst(conn), addr, sizeof(addr));

	LOG_INF("Pairing failed conn: %s, reason %d", addr, reason);
}


static struct bt_conn_auth_cb conn_auth_callbacks = {
	.passkey_display = auth_passkey_display,
	.passkey_confirm = auth_passkey_confirm,
	.cancel = auth_cancel,
};

static struct bt_conn_auth_info_cb conn_auth_info_callbacks = {
	.pairing_complete = pairing_complete,
	.pairing_failed = pairing_failed
};
#else
static struct bt_conn_auth_cb conn_auth_callbacks;
static struct bt_conn_auth_info_cb conn_auth_info_callbacks;
#endif


static void bt_receive_cb(struct bt_conn *conn, const uint8_t *const data,
			  uint16_t len)
{
	char addr[BT_ADDR_LE_STR_LEN] = {0};

	bt_addr_le_to_str(bt_conn_get_dst(conn), addr, ARRAY_SIZE(addr));

	LOG_INF("Received from: %s, data: %s", addr, data);

	for (uint16_t pos = 0; pos != len;) {
		struct uart_data_t *tx = k_malloc(sizeof(*tx));

		if (!tx) {
			LOG_WRN("Not able to allocate UART send data buffer");
			return;
		}

		size_t tx_data_size = sizeof(tx->data) - 1;

		if ((len - pos) > tx_data_size) {
			tx->len = tx_data_size;
		} else {
			tx->len = (len - pos);
		}

		memcpy(tx->data, &data[pos], tx->len);

		pos += tx->len;

		if ((pos == len) && (data[len - 1] == '\r')) {
			tx->data[tx->len] = '\n';
			tx->len++;
		}
		procRxBle((uint8_t *)tx->data, tx->len);
		k_free(tx);	
	}
}

static struct bt_nus_cb nus_cb = {
	.received = bt_receive_cb,
};


#define DEVICE_NAME "wbiz_nrf_123"
#define DEVICE_NAME_LEN	(sizeof(DEVICE_NAME) - 1)

// static const struct bt_data ad[] = {
// 	BT_DATA_BYTES(BT_DATA_FLAGS, (BT_LE_AD_GENERAL | BT_LE_AD_NO_BREDR)),
// 	// BT_DATA(BT_DATA_NAME_COMPLETE, adTemp, 20),
// 	BT_DATA(BT_DATA_NAME_COMPLETE, DEVICE_NAME, DEVICE_NAME_LEN),
// };

void initBle(void){
	int err = 0;
	err = uart_init();
	printk("----------------\r\n");
	printk("now start initBle. 2023.12.08. 15:13\r\n");

	if (IS_ENABLED(CONFIG_BT_NUS_SECURITY_ENABLED)) {
		err = bt_conn_auth_cb_register(&conn_auth_callbacks);
		if (err) {
			printk("Failed to register authorization callbacks.\n");
		}

		err = bt_conn_auth_info_cb_register(&conn_auth_info_callbacks);
		if (err) {
			printk("Failed to register authorization info callbacks.\n");
		}
	}

	err = bt_enable(NULL);

	LOG_INF("Bluetooth initialized");

	k_sem_give(&ble_init_ok);

	if (IS_ENABLED(CONFIG_SETTINGS)) {
		settings_load();
	}

	err = bt_nus_init(&nus_cb);
	if (err) {
		LOG_ERR("Failed to initialize UART service (err: %d)", err);
	}

	whybiz_t* pFactor = getWhybizFactor();

	uint8_t test[20] = {0, }; 
	printk("ble: %d\r\n", pFactor->ble);
	sprintf(test, "wbiz_nrf_%d", pFactor->ble);
struct bt_data ad_hong[] = {
	BT_DATA_BYTES(BT_DATA_FLAGS, (BT_LE_AD_GENERAL | BT_LE_AD_NO_BREDR)),
	// BT_DATA(BT_DATA_NAME_COMPLETE, adTemp, 20),
	BT_DATA(BT_DATA_NAME_COMPLETE, test, DEVICE_NAME_LEN),
};

	err = bt_le_adv_start(BT_LE_ADV_CONN, ad_hong, ARRAY_SIZE(ad_hong), sd,
			      ARRAY_SIZE(sd));
	if (err) {
		LOG_ERR("Advertising failed to start (err %d)", err);
	}

}

void procRxBle(uint8_t* data, uint16_t len){
	printk("procRxData len: %d \r\n", len);
	uint8_t category = data[0];
	uint8_t sensor = data[1];
	uint8_t value = data[2];
	whybiz_t* pFactor = getWhybizFactor();
	printk("ca: %d, se: %d, value: %d\r\n", category, sensor, value);
	switch(category){
		case CTR_RELAY:
			printk("relay setting\r\n");
			writeOutSx(sensor, value);
		break;
		case CTR_LORA:
			printk("lora setting by ble. tbd(2023.12.14)\r\n");
			// writeOutSx(sensor, value);
		break;
		case CTR_CHANNEL:
			pFactor->channel = sensor - 1;
			setUartChannel(pFactor->channel);
			printk("channel setting by ble. tbd(2023.12.14)\r\n");
		break;
	}
}

void sendToMobile(uint8_t* buf, uint8_t len){
	connectFlag_t* pFlag = getConnectFlag();
	if(pFlag->ble){
		if (bt_nus_send(NULL, buf, len)) {
			LOG_WRN("Failed to send data over BLE connection");
		}
	}
}

void procChannel(void){
	uint8_t buf[3] = {0, };
    whybiz_t* pFactor = getWhybizFactor();

	buf[0] = CHANNEL_DEVICE; buf[1] = pFactor->channel; buf[2] = pFactor->lora_ch;
	sendToMobile(buf, sizeof(buf));
}

#include "adc.h"
void procAdcTxBle(void){
	printk("procAdcTxBle\r\n");
	readAdcValue();
	uint8_t buf[3] = {0, };
    whybiz_t* pFactor = getWhybizFactor();

	buf[0] = ADC_DEVICE; buf[1] = pFactor->adc1; buf[2] = pFactor->adc2;
	sendToMobile(buf, sizeof(buf));
}

void procSwitchTxBle(void){
	readSxSw();
	uint8_t buf[3] = {0, };
    whybiz_t* pFactor = getWhybizFactor();

	buf[0] = SWITCH_DEVICE; buf[1] = pFactor->sw; buf[2] = pFactor->sw;
	sendToMobile(buf, sizeof(buf));
}

// void procRelayTxBle(uint8_t num, uint8_t value){
void procRelayTxBle(void){
	readSxRelay();
	uint8_t buf[3] = {0, };
    whybiz_t* pFactor = getWhybizFactor();

	buf[0] = RELAY_DEVICE; buf[1] = pFactor->relay; buf[2] = pFactor->relay;
	sendToMobile(buf, sizeof(buf));
}

void procLora(void){
	uint8_t buf[3] = {0, };
    whybiz_t* pFactor = getWhybizFactor();

	buf[0] = LORA_DEVICE; buf[1] = pFactor->power; buf[2] = pFactor->rssi;
	sendToMobile(buf, sizeof(buf));
}

void procVersion(void){
	uint8_t buf[3] = {0, };
    whybiz_t* pFactor = getWhybizFactor();

	buf[0] = VERSION_DEVICE; buf[1] = pFactor->version; buf[2] = pFactor->ble;
	sendToMobile(buf, sizeof(buf));
}


jsonFrame_t myJson = {0, };

void getJsonData(uint8_t* pBuf, uint8_t len){
	for(int i = 0; i < len; i++){
		myJson.frame[i] = *pBuf++;
		if(myJson.frame[i] == '{') myJson.start = i;
		else if(myJson.frame[i] == '}'){
			myJson.end = i;
			myJson.flag = 1;
		} 
	} 

}

void clearJsonData(void){
	for(int i = 0; i < sizeof(myJson.frame); i++) myJson.frame[i] = 0;
	myJson.flag = myJson.end = myJson.start = 0;
}

jsonFrame_t* getJsonFrame(void){
	return &myJson;
}

void dispJsonFrame(void){

	printk("start: %d, end: %d\r\n", myJson.start, myJson.end);
	printk("result: %s\r\n", myJson.frame);
}

void ble_write_thread(void)
{
	/* Don't go any further until BLE is initialized */
	k_sem_take(&ble_init_ok, K_FOREVER);
// test3
	for (;;) {
		/* Wait indefinitely for data to be sent over bluetooth */
		struct uart_data_t *buf = k_fifo_get(&fifo_uart_rx_data,
						     K_FOREVER);

		// LOG_INF("ble_write_thread: %d", buf->len);
/*
		printk("ble_write_thread: %d\r\n", buf->len);
		printk("buf: %s\r\n", buf->data);
*/
		// printk("---->%s\r\n", buf->data);
		// LOG_INF("---->%s", buf->data);
		getJsonData(buf->data, buf->len);	
		k_free(buf);
	}
	LOG_INF("ble_write_thread");
}

K_THREAD_DEFINE(ble_write_thread_id, STACKSIZE, ble_write_thread, NULL, NULL,
		NULL, PRIORITY, 0, 0);
```

## src/myBle.h
```c
#ifndef MYBLE__H__
#define MYBLE__H__
// 	BT_UUID_128_ENCODE(0x6e400001, 0xb5a3, 0xf393, 0xe0a9, 0xe50e24dcca9e)
// 	Service UUID: 			6e400001-b5a3-f393-e0a9-e50e24dcca9e
// 	Tx Characteristic UUID: 6e400003-b5a3-f393-e0a9-e50e24dcca9e
// 	Rx Characteristic UUID: 6e400002-b5a3-f393-e0a9-e50e24dcca9e

void initBle(void);
void procRxBle(uint8_t* data, uint16_t len);
void procTxBle(void);

void procSwitchTxBle(void);
// void procRelayTxBle(uint8_t num, uint8_t value);
void procRelayTxBle(void);
void procAdcTxBle(void);
#endif 
```

## src/nvm.c
```c
#include <zephyr/kernel.h>
#include <zephyr/sys/reboot.h>
#include <zephyr/device.h>
#include <string.h>
#include <zephyr/drivers/flash.h>
#include <zephyr/storage/flash_map.h>
#include <zephyr/fs/nvs.h>

#include "nvm.h"

static struct nvs_fs fs;

#define NVS_PARTITION		storage_partition
#define NVS_PARTITION_DEVICE	FIXED_PARTITION_DEVICE(NVS_PARTITION)
#define NVS_PARTITION_OFFSET	FIXED_PARTITION_OFFSET(NVS_PARTITION)

#define UTTEC_ID 2 

// static uttec_t myUttec = {0, };
#include "uttec.h"

void dispFactors(void){
	whybiz_t* pWhybiz = getWhybizFactor();
	printk("============= whybiz factors ==========\r\n");
	printk("version: %d\r\n", pWhybiz->version);
	printk("node: %d\r\n", pWhybiz->node);
	printk("uart: %d\r\n", pWhybiz->channel);
	printk("ble: %d\r\n", pWhybiz->ble);
	printk("adc1: %d\r\n", pWhybiz->adc1);
	printk("adc2: %d\r\n", pWhybiz->adc2);
	printk("sw: %d\r\n", pWhybiz->sw);
	printk("relay: %d\r\n", pWhybiz->relay);
	printk("lora_ch: %d\r\n", pWhybiz->lora_ch);
	printk("power: %d\r\n", pWhybiz->power);
	printk("rssi: %d\r\n", pWhybiz->rssi);
	printk("============= whybiz factors ==========\r\n");
	k_sleep(K_MSEC(1000));
}

void initNvm(void){
    int rc = 0;
	struct flash_pages_info info;
	whybiz_t* pWhybiz = getWhybizFactor();

	fs.flash_device = NVS_PARTITION_DEVICE;
	if (!device_is_ready(fs.flash_device)) {
		printk("Flash device %s is not ready\n", fs.flash_device->name);
	}
	fs.offset = NVS_PARTITION_OFFSET;
	rc = flash_get_page_info_by_offs(fs.flash_device, fs.offset, &info);
	if (rc) {
		printk("Unable to get page info\n");
	}
	fs.sector_size = info.size;
	fs.sector_count = 3U;

	rc = nvs_mount(&fs);
	if (rc) {
		printk("Flash Init failed\n");
	}                    

	rc = nvs_read(&fs, UTTEC_ID, pWhybiz, sizeof(whybiz_t));

	if(pWhybiz->flashFlag == FLASH_FLAG){
		printk("Already written to flash factors\r\n");
		printk("version: %d\r\n", pWhybiz->version);			
	}
	else{
		printk("New Program. now set first factors\r\n");
		pWhybiz->flashFlag = FLASH_FLAG;
		pWhybiz->version = 1;
		pWhybiz->node = 111;
		pWhybiz->channel = 0;
		pWhybiz->ble = 123;
		pWhybiz->adc1 = 0;
		pWhybiz->adc2 = 0;
		pWhybiz->sw = 0;
		pWhybiz->relay = 0xff;
		pWhybiz->lora_ch = 20;
		pWhybiz->power = 16;
		pWhybiz->rssi = 0;
		(void)nvs_write(&fs, UTTEC_ID, pWhybiz, sizeof(whybiz_t)+1);
	}
	dispFactors();
}

void testNvm(void){
    int rc = 0;
	whybiz_t* pWhybiz = getWhybizFactor();

	rc = nvs_read(&fs, UTTEC_ID, pWhybiz, sizeof(whybiz_t));
	if (rc > 0) { /* item was found, show it */
		printk("version: %d, node: %d\n", pWhybiz->version, pWhybiz->node);
		pWhybiz->version++;
		(void)nvs_write(&fs, UTTEC_ID, pWhybiz, sizeof(whybiz_t)+1);
	} else   {/* item was not found, add it */
		printk("flash write read error\r\n");
	}
}

void saveFactorToFlash(void){
	whybiz_t* pWhybiz = getWhybizFactor();
	(void)nvs_write(&fs, UTTEC_ID, pWhybiz, sizeof(whybiz_t)+1);
}
```

## src/nvm.h
```c
#ifndef NVM__H__
#define NVM__H__

void initNvm(void);

void dispFactors(void);

void testNvm(void);

void writeFactor(void);


#endif 
```

## src/sx1509.c
```c
#include <zephyr/kernel.h>
#include <zephyr/drivers/gpio.h>
#include <zephyr/sys/printk.h>
#include <zephyr/devicetree.h> 
#include <zephyr/drivers/i2c.h>

#include "uttec.h"
#include "myBle.h"
#include "sx1509.h"

#define SX1509_ADDRESS		0x3e
#define I2C_NODE DT_NODELABEL(arduino_i2c)

static const struct device *i2c0_dev = DEVICE_DT_GET(I2C_NODE);
// static uint8_t sx1509_in = 0;

void initSxRelay(void){
	for(int i = 0; i < 8; i++){
		writeOutSx(i, 0);
		k_sleep(K_MSEC(100));
	}
}

void initSx1509(void){
	int err;
	uint8_t buf[2];

	if(!device_is_ready(i2c0_dev)){
		printk("i2c_dev is not ready ----------->\r\n");
		while(1);
	}

	buf[0] = 0x00; buf[1] = 0x00; //port b, input enable	
	err = i2c_write(i2c0_dev, buf, 2, SX1509_ADDRESS);
	buf[0] = 0x01; buf[1] = 0x00; //port a, input enable
	err = i2c_write(i2c0_dev, buf, 2, SX1509_ADDRESS);

	buf[0] = 0x06; buf[1] = 0xff; //port b, pull up
	err = i2c_write(i2c0_dev, buf, 2, SX1509_ADDRESS);
	buf[0] = 0x07; buf[1] = 0xff; //port a, pull up
	err = i2c_write(i2c0_dev, buf, 2, SX1509_ADDRESS);
	buf[0] = 0x0e; buf[1] = 0x00; //port b, output
	err = i2c_write(i2c0_dev, buf, 2, SX1509_ADDRESS);
	buf[0] = 0x0f; buf[1] = 0xff; //port a, input
	err = i2c_write(i2c0_dev, buf, 2, SX1509_ADDRESS);
	if(err < 0){
		printk("i2c write fail------------\r\n");		// return 0;
		while(1);
	}
	initSxRelay();
	printk("relay status: %x, sw status: %x\r\n", 
		readSxRelay(), readSxSw());

	printk("------> end of initSx1509\r\n");
}

uint8_t readSxRelay(void){
	int err;
	uint8_t buf = 0x10;
	whybiz_t* pWhybiz = getWhybizFactor();

	err = i2c_write(i2c0_dev, &buf, 1, SX1509_ADDRESS);
	if(err < 0){
		printk("i2c write fail------------\r\n");
	}
	err = i2c_read(i2c0_dev, &buf, 1, SX1509_ADDRESS);
	if(err < 0){
		printk("i2c write fail------------\r\n");
	}
	pWhybiz->relay = buf;
	return pWhybiz->relay;
}

uint8_t readSxSw(void){
	int err;
	uint8_t buf = 0x11;
	whybiz_t* pWhybiz = getWhybizFactor();

	err = i2c_write(i2c0_dev, &buf, 1, SX1509_ADDRESS);
	if(err < 0){
		printk("i2c write fail------------\r\n");
	}
	err = i2c_read(i2c0_dev, &buf, 1, SX1509_ADDRESS);
	if(err < 0){
		printk("i2c write fail------------\r\n");
	}
	pWhybiz->sw = buf;
	return pWhybiz->sw;
}

bool checkSx1509In(void){
	static uint16_t testCount = 0;
	uint8_t swNow = readSxSw();
	sx1509_t* pBefore = getBeforeSxReg();

	if(pBefore->sw == swNow){
		printk("now and before same: %d\r\n", testCount++);
		return 0;	
	} 		
	printk("now: %x, reg: %x\r\n", swNow, pBefore->sw);
	whybizFrame_t* pJson = getWhybizFrame();
	pJson->node = 1;
	pJson->category = SWITCH_DEVICE;
	pJson->sensor = swNow;
	pJson->value = swNow;
	procSwitchTxBle();

	// for(int i = 0; i < 8; i++){
	// 	uint8_t test = 0x01;
	// 	test = test << i;
	// 	uint8_t tempNow = swNow & test;
	// 	uint8_t tempBefore = pBefore->sw & test; 
	// 	if(tempBefore != tempNow){
	// 		pJson->sensor = i;
	// 		pJson->value = tempNow;

	// 		printk("send Change report: %d, %x\r\n", i, tempNow);
	// 		k_sleep(K_MSEC(100));
	// 		procSwitchTxBle(i, tempNow);
	// 		sendWhybizFrame();
	// 	}
	// }
	pBefore->sw = swNow;
	return true;
}

uint8_t readOutSxRelay(void){
	int err;
	uint8_t buf = 0x10;

	err = i2c_write(i2c0_dev, &buf, 1, SX1509_ADDRESS);
	if(err < 0){
		printk("i2c write fail------------\r\n");
	}
	err = i2c_read(i2c0_dev, &buf, 1, SX1509_ADDRESS);
	if(err < 0){
		printk("i2c write fail------------\r\n");
	}
	printk("read buf: %x\r\n", buf);
	return buf;
}

void writeOutSx(uint8_t bitNum, bool output){
	uint8_t regB = readOutSxRelay();
	int err;
	printk("~BIT_0: %x\r\n", (uint8_t)~BIT_0);

	switch(bitNum){
		case 0:
			if(output) regB = regB | (uint8_t)~BIT_0;
			else regB = regB & BIT_0;
		break;
		case 1:
			if(output) regB = regB | (uint8_t)~BIT_1;
			else regB = regB & BIT_1;
		break;
		case 2:
			if(output) regB = regB | (uint8_t)~BIT_2;
			else regB = regB & BIT_2;
		break;
		case 3:
			if(output) regB = regB | (uint8_t)~BIT_3;
			else regB = regB & BIT_3;
		break;
		case 4:
			if(output) regB = regB | (uint8_t)~BIT_4;
			else regB = regB & BIT_4;
		break;
		case 5:
			if(output) regB = regB | (uint8_t)~BIT_5;
			else regB = regB & BIT_5;
		break;
		case 6:
			if(output) regB = regB | (uint8_t)~BIT_6;
			else regB = regB & BIT_6;
		break;
		case 7:
			if(output) regB = regB | (uint8_t)~BIT_7;
			else regB = regB & BIT_7;
		break;
	}
	uint8_t buf[2];
	buf[0] = 0x10; buf[1] = regB; //regB, all high
	err = i2c_write(i2c0_dev, buf, 2, SX1509_ADDRESS);
	if(err < 0){
		printk("i2c write fail------------\r\n");
	}
	printk("regB: %x\r\n", regB);
}

// void setRelay()
void testRelay(void){
	static uint16_t count = 0;
	switch(count%16){
		case 0: writeOutSx(count%8, true); break;
		case 1: writeOutSx(count%8, true); break;
		case 2: writeOutSx(count%8, true); break;
		case 3: writeOutSx(count%8, true); break;
		case 4: writeOutSx(count%8, true); break;
		case 5: writeOutSx(count%8, true); break;
		case 6: writeOutSx(count%8, true); break;
		case 7: writeOutSx(count%8, true); break;
		case 8: writeOutSx(count%8, false); break;
		case 9: writeOutSx(count%8, false); break;
		case 10: writeOutSx(count%8, false); break;
		case 11: writeOutSx(count%8, false); break;
		case 12: writeOutSx(count%8, false); break;
		case 13: writeOutSx(count%8, false); break;
		case 14: writeOutSx(count%8, false); break;
		case 15: writeOutSx(count%8, false); break;
	}
	count++;
}

void testSw(void){
}
```

## src/sx1509.h
```c
#ifndef SX1509__H__
#define SX1509__H__


#define BIT_0 0B11111110
#define BIT_1 0B11111101
#define BIT_2 0B11111011
#define BIT_3 0B11110111
#define BIT_4 0B11101111
#define BIT_5 0B11011111
#define BIT_6 0B10111111
#define BIT_7 0B01111111

void initSxRelay(void);
void initSx1509(void);
uint8_t readSxRelay(void);
uint8_t readSxSw(void);

bool checkSx1509In(void);

void writeOutSx(uint8_t bitNum, bool output);

void testRelay(void);
void testSw(void);

#endif 
```

## src/uttec.c
```c
#include <zephyr/kernel.h>
#include <zephyr/drivers/gpio.h>

#include <zephyr/data/json.h>

#include "uttec.h"
#include <zephyr/logging/log.h>
#include "adc.h"
#include "myBle.h"
#include "nvm.h"

whybiz_t myWhybiz = {0, };

sx1509_t beforeSx1509 = {0, };

struct whybiz{
    uint8_t no;
    uint8_t ca;
    uint8_t se;
    uint8_t va;
    uint8_t crc;
};

static const struct json_obj_descr whybiz_descr[] = {
  JSON_OBJ_DESCR_PRIM(struct whybiz, no, JSON_TOK_NUMBER),
  JSON_OBJ_DESCR_PRIM(struct whybiz, ca, JSON_TOK_NUMBER),
  JSON_OBJ_DESCR_PRIM(struct whybiz, se, JSON_TOK_NUMBER),
  JSON_OBJ_DESCR_PRIM(struct whybiz, va, JSON_TOK_NUMBER),
  JSON_OBJ_DESCR_PRIM(struct whybiz, crc, JSON_TOK_NUMBER),
};

#define SELECT1_NODE DT_NODELABEL(select1)
#define SELECT2_NODE DT_NODELABEL(select2)
#define LORARST_NODE DT_NODELABEL(lorarst)
#define PWR_CRL_NODE DT_NODELABEL(pwrctl)
#define RS485TX_NODE DT_NODELABEL(rs485tx)


static const struct gpio_dt_spec select1 = GPIO_DT_SPEC_GET(SELECT1_NODE, gpios);
static const struct gpio_dt_spec select2 = GPIO_DT_SPEC_GET(SELECT2_NODE, gpios);
static const struct gpio_dt_spec loraRst = GPIO_DT_SPEC_GET(LORARST_NODE, gpios);
static const struct gpio_dt_spec pwrCtl = GPIO_DT_SPEC_GET(PWR_CRL_NODE, gpios);
static const struct gpio_dt_spec rs485_en = GPIO_DT_SPEC_GET(RS485TX_NODE, gpios);

whybiz_t* getWhybizFactor(void){
    return &myWhybiz;    
}

void initPort(void){
	whybiz_t* pWhybiz = getWhybizFactor();
	gpio_pin_configure_dt(&select1, GPIO_OUTPUT_ACTIVE);
	gpio_pin_configure_dt(&select2, GPIO_OUTPUT_ACTIVE);
	gpio_pin_configure_dt(&loraRst, GPIO_OUTPUT_ACTIVE);
	gpio_pin_configure_dt(&pwrCtl, GPIO_OUTPUT_ACTIVE);
	gpio_pin_configure_dt(&rs485_en, GPIO_OUTPUT_ACTIVE);

    gpio_pin_set_dt(&select1, 1);//set low
    gpio_pin_set_dt(&select2, 1);//set low
    gpio_pin_set_dt(&loraRst, 0);//set high
    gpio_pin_set_dt(&pwrCtl, 1);//set low
    gpio_pin_set_dt(&rs485_en, 1);//set low

    setUartChannel(pWhybiz->channel);
    // setUartChannel(1); // for server test. 2023.12.12. 15:50
}

void setUartChannel(uint8_t channel){
    switch(channel){
        case 0: 
            gpio_pin_set_dt(&select2, 1); gpio_pin_set_dt(&select1, 1); 
            printk("Ethernet channel\r\n");
        break;
        case 1:
            gpio_pin_set_dt(&select2, 1); gpio_pin_set_dt(&select1, 0); 
            printk("rs485 channel\r\n");
        break;
        case 2:
            gpio_pin_set_dt(&select2, 0); gpio_pin_set_dt(&select1, 1); 
            printk("lora channel\r\n");
        break;
        case 3:
            gpio_pin_set_dt(&select2, 0); gpio_pin_set_dt(&select1, 0); 
            printk("tbd channel\r\n");
        break;
        default: printk("error channel: %d\r\n", channel);
    }
}

sx1509_t* getBeforeSxReg(void){
    return &beforeSx1509;
}

#include "sx1509.h"
void uttecJsonTest(uint8_t* pData, uint8_t len){
    uint8_t test_msg[100] = {0,};
    for(int i = 0; i < len; i++) test_msg[i] = *pData++;

    uint16_t length = len;
    struct whybiz ctr;
    
    int16_t ret = json_obj_parse(test_msg, length,
                    whybiz_descr,
                    ARRAY_SIZE(whybiz_descr),
                    &ctr);
    
    if (ret < 0)
    {
        // LOG_INF("JSON Parse Error: %d\r\n", ret);
        printk("JSON Parse Error ----------->");
    }
    else
    {
        whybiz_t* pFactor = getWhybizFactor();
        switch(ctr.ca){
            case CTR_RELAY:
                printk("no:%d, ca:%d, se:%d, va:%d, crc:%d\r\n",
                ctr.no, ctr.ca, ctr.se, ctr.va, ctr.crc);
                writeOutSx(ctr.se, ctr.va);
            break;
            case CTR_LORA:
            case SET_LORA:
                pFactor->power = ctr.se;
                printk("set lora power-> se: %d, va: %d\r\n", 
                    ctr.se, ctr.va);
                printk("save factor ###########\r\n");
                saveFactorToFlash();
            break;
            case CTR_CHANNEL:
            case SET_CHANNEL:
                pFactor->channel = ctr.se; pFactor->lora_ch = ctr.va;
                printk("set channel-> uart: %d, lora: %d\r\n", 
                    ctr.se, ctr.va);
                printk("save factor ###########\r\n");
                setUartChannel(pFactor->channel);
                saveFactorToFlash();
            break;
            case SET_VERSION:
                pFactor->version = ctr.se; pFactor->ble = ctr.va;
                pFactor->node = ctr.va;
                printk("set number-> node: %d, ble: %d\r\n", 
                    ctr.se, ctr.va);
                printk("save factor ###########\r\n");
                saveFactorToFlash();
            break;
            default: printk("error category: %d\r\n", ctr.ca); break;
        }
    }
}

whybizFrame_t myWhybizFrame = {0, };

void sendWhybizFrame(void){
    whybizFrame_t* pJson = getWhybizFrame();
    pJson->crc = pJson->node + pJson->category + pJson->sensor + pJson->sensor;
    printk("{\"no\":%d,\"ca\":%d,\"se\":%d,\"va\":%d,\"crc\":%d}\r\n",
    pJson->node, pJson->category, pJson->sensor, pJson->value, pJson->crc);
}

whybizFrame_t* getWhybizFrame(void){
    return &myWhybizFrame;
}

void testJsonOut(void){
    static uint8_t count = 0;
    myWhybizFrame.node = 1;
    myWhybizFrame.category = 2;
    myWhybizFrame.sensor = count % 8;
    myWhybizFrame.value = count;
    count++;
    getWhybizFrame();
}


void sendFactorAtConnection(void){
    whybiz_t* pFactor = getWhybizFactor();
    printk("------> sendFactorAtConnection\r\n");
    for(int i = 0; i < MAX_CATEGORY; i++){
        switch(i){
            case CHANNEL_DEVICE:
                procChannel();
                printk("channel: %d, lora ch: %d\r\n", 
                    pFactor->channel, pFactor->lora_ch);
            break;
            case ADC_DEVICE:
                procAdcTxBle();
                printk("sw: %d\r\n", pFactor->sw);
            break;
            case SWITCH_DEVICE: 
                procSwitchTxBle();
                printk("relay: %d\r\n", pFactor->relay);
            break;
            case RELAY_DEVICE: 
                procRelayTxBle();
                printk("adc1: %d, adc2: %d\r\n", pFactor->adc1, pFactor->adc2);
            break;
            case LORA_DEVICE: 
                procLora();
                printk("power: %d, rssi: %d\r\n", 
                    pFactor->power, pFactor->rssi);
            break;
            case VERSION_DEVICE:
                procVersion();
                printk("version: %d, ble num: %d\r\n", 
                    pFactor->version, pFactor->ble);
            break;
        }
        k_sleep(K_MSEC(20));
    }
}

void sendJsonForStatus(void){
    static uint32_t count = 0;
    whybiz_t* pFactor = getWhybizFactor();
    whybizFrame_t* pFrame = getWhybizFrame();

    connectFlag_t* pFlags = getConnectFlag();

    if(!(count++ % 2)){
        static uint32_t sendCount = 0;
        uint8_t who = (sendCount++ % MAX_CATEGORY);
        pFrame->node = pFactor->node;
        // printk("who: %d\r\n", who);
        switch(who){
            case ADC_DEVICE: 
                printk("ADC_DEVICE: %d\r\n", who); 
                pFrame->category = ADC_DEVICE; 
                pFrame->sensor = pFactor->adc1; pFrame->value = pFactor->adc2; 
                procAdcTxBle();
            break;
            case SWITCH_DEVICE: printk("SWITCH_DEVICE: %d\r\n", who); 
                pFrame->category = SWITCH_DEVICE; 
                pFrame->sensor = pFactor->sw; pFrame->value = pFactor->sw; 
                procSwitchTxBle();
            break;
            case RELAY_DEVICE: printk("RELAY_DEVICE: %d\r\n", who); 
                pFrame->category = RELAY_DEVICE; 
                pFrame->sensor = pFactor->relay; pFrame->value = pFactor->relay; 
                procRelayTxBle();
            break;
            case LORA_DEVICE: printk("LORA_DEVICE: %d\r\n", who); 
                pFrame->category = LORA_DEVICE; 
                pFrame->sensor = pFactor->power; pFrame->value = pFactor->rssi++; 
                procLora();
            break;
            case VERSION_DEVICE: printk("VERSION_DEVICE: %d\r\n", who); 
                pFrame->category = VERSION_DEVICE; 
                pFrame->sensor = pFactor->version; pFrame->value = pFactor->ble; 
                procVersion();
            break;
            case CHANNEL_DEVICE: printk("CHANNEL_DEVICE: %d\r\n", who); 
                pFrame->category = CHANNEL_DEVICE; 
                pFrame->sensor = pFactor->channel; pFrame->value = pFactor->lora_ch; 
                procChannel();
            break;
        }
        pFrame->crc = pFrame->node + pFrame->category + pFrame->sensor + pFrame->value;  
        
        gpio_pin_set_dt(&rs485_en, 0);//set high, for tx
        delay(1);
        if(pFactor->channel == LORA_CHANNEL) printf("at=u");
        // printf("{\"ca\":%d,\"se\":%d,\"va\":%d}\r\n",
        // pFrame->category, pFrame->sensor, pFrame->value);
        
        printf("{\"no\":%d,\"ca\":%d,\"se\":%d,\"va\":%d,\"crc\":%d}\r\n",
        pFrame->node, pFrame->category, pFrame->sensor, pFrame->value, pFrame->crc);
        delay(5);
        // printk("{\"no\":%d,\"ca\":%d,\"se\":%d,\"va\":%d,\"crc\":%d}\r\n",
        // pFrame->node, pFrame->category, pFrame->sensor, pFrame->value, pFrame->crc);
        
        gpio_pin_set_dt(&rs485_en, 1);//set low, for rx

    }
}

void dispChannel(void){
    whybiz_t* pFactor = getWhybizFactor();
    switch(pFactor->channel){
        case 0: printk("uart: Ethernet--> %d\r\n", pFactor->channel); break;
        case 1: printk("uart: rs485--> %d\r\n", pFactor->channel); break;
        case 2: printk("uart: lora--> %d\r\n", pFactor->channel); break;
        case 3: printk("uart: T.B.D--> %d\r\n", pFactor->channel); break;
    }
}

void delay(uint16_t msec){
    k_sleep(K_MSEC(msec));
}
```

## src/uttec.h
```c
#ifndef UTTEC__H__
#define UTTEC__H__

#include <stdio.h>
#include <stdbool.h>

// for uart channel
#define ETHERNET_CHANNEL  0
#define RS485_CHANNEL     1
#define LORA_CHANNEL      2
#define BLANK_CHANNEL     3    

// for status
#define ADC_DEVICE		    1
#define SWITCH_DEVICE 	    2
#define RELAY_DEVICE	    3
#define LORA_DEVICE	        4
#define VERSION_DEVICE	    5
#define CHANNEL_DEVICE		6
// #define BLE_NUM_DEVICE	    6
#define MAX_CATEGORY        CHANNEL_DEVICE + 1
#define MAX_BLE_CATEGORY    4
// end

// for control
#define CTR_RELAY           13
#define CTR_LORA            14
#define CTR_CHANNEL         16
// end

// for control
#define SET_LORA            24
#define SET_VERSION         25
#define SET_CHANNEL         26
// end

#define FLASH_FLAG      0xaaaa 

typedef struct{
    uint16_t flashFlag;
    uint8_t version;
    uint8_t node;
    uint8_t channel;
    uint8_t ble;
    int8_t  adc1;
    int8_t  adc2;
    uint8_t sw;
    uint8_t relay;
    uint8_t lora_ch;
    uint8_t power;
    int8_t  rssi;
} whybiz_t;

typedef struct{
    uint16_t src_pid;
    uint16_t src_addr;
    int rssi;
} loraFactor_t;

typedef struct{
    uint8_t relay;
    uint8_t sw;
} sx1509_t;

typedef struct{
    bool first;
    bool ble;
    bool wifi;
    bool ethernet;
    bool rs485;
} connectFlag_t;

typedef struct{
    uint8_t node;
    uint8_t category;
    uint8_t sensor;
    uint8_t value;
    uint16_t crc;
} whybizFrame_t;

typedef struct{
    uint8_t frame[200];
    uint8_t start;
    uint8_t end;
    uint8_t flag;
} jsonFrame_t;

void initPort(void);
void setUartChannel(uint8_t channel);

void uttecJsonTest(uint8_t* pData, uint8_t len);

sx1509_t* getBeforeSxReg(void);
whybiz_t* getWhybizFactor(void);

void sendWhybizFrame(void);
whybizFrame_t* getWhybizFrame(void);
void testJsonOut(void);


void clearJsonData(void);
jsonFrame_t* getJsonFrame(void);
void dispJsonFrame(void);

connectFlag_t* getConnectFlag(void);
void sendFactorAtConnection(void);


void procChannel(void);
void procLora(void);
void procVersion(void);

void sendJsonForStatus(void);

void dispChannel(void);

void delay(uint16_t msec);

#endif 
```
